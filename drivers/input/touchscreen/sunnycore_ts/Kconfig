## drivers/input/touchscreen/sunnycore_ts/Kconfig
```kconfig
#
# SunnyCore Touchscreen driver configuration
#

config TOUCHSCREEN_SC
        bool "SunnyCore Touchscreen"
		depends on I2C
		default n
		help
		  Say Y here if you have Focaltech touch panel.
		  If unsure, say N.

config TOUCHSCREEN_SC_DIRECTORY
    string "SunnyCore ts directory name"
    default "SunnyCore"
    depends on TOUCHSCREEN_SC
    
```

## drivers/misc/mediatek/prize/Kconfig
```kconfig
config PRIZE_LCD_BIAS
  bool CONFIG_PRIZE_LCD_BIAS
  default no
  help
    CONFIG_PRIZE_LCD_BIAS

# prize-dingjun-20150410-start
config PRIZE_HALL
	bool "hall device"
	default n
	help
	  Select Y to enable hall device support
# prize-dingjun-20150410-end

#prize add by huarui, sos torch , 20200402 start
config PRIZE_TORCH
	bool "torch with fun"
	default n
	help
	  Select Y to enable prize torch
#prize add by huarui, sos torch , 20200402 start

#prize add by huarui, hoperf hp5804 , 20200402 start
config PRIZE_BAROMETER_H5804
	bool "water barometer with h5804"
	default n
	help
	  Select Y to enable water barometer
#prize add by huarui, hoperf hp5804 , 20200402 start

config PRIZE_SCR_RTL
	bool "scr rtl"
	default n
	help
	  Select Y to enable prize scr rtl

#prize add by huangjiwu, fm ant , 20200720 start
config PRIZE_FM_ANT_SWITCH
	bool "fm ant switch fun"
	default n
	help
	  Select Y to enable prize fm ant switch fun
#prize add by huarui, fm ant switch , 20200720 start

#prize added by chenjiaxi, prize_dual_camera driver, 20190111-start
source "drivers/misc/mediatek/prize/dual_camera/Kconfig"
#prize added by chenjiaxi, prize_dual_camera driver, 20190111-end

#prize added by chenjiaxi, prize_dual_camera_als driver, 20200922-start
source "drivers/misc/mediatek/prize/dual_camera_als/Kconfig"
#prize added by chenjiaxi, prize_dual_camera_als driver, 20200922-end

#prize add by huarui, haptic drv , 20200402 start
config PRIZE_HAPTIC_AW8695
	tristate "haptic drv IC driver"
	default n
	depends on !MTK_VIBRATOR
	  ---help---
	  Vibrator driver support for MediaTek SOC.
#prize add by huarui, haptic drv , 20200402 start

#prize-add prize-wangyunqing-20181110-start
source "drivers/misc/mediatek/prize/hardware_info/Kconfig"
#prize-add prize-wangyunqing-20181110-end

#prize-add prize-zhaopengge-20200915-start
source "drivers/misc/mediatek/prize/aw2028_led/Kconfig"
source "drivers/misc/mediatek/prize/aw2015/Kconfig"
#prize-add prize-zhaopengge-20200915-end

#prize added by chenjiaxi, ir camera motor drv, 20201117-start
source "drivers/misc/mediatek/prize/ir_camera_motor/Kconfig"
#prize added by chenjiaxi, ir camera motor drv, 20201117-end

source "drivers/misc/mediatek/prize/lcd_bias/Kconfig"
```

## drivers/misc/mediatek/prize/dual_camera_als/Kconfig
```kconfig
config PRIZE_DUAL_CAMERA_ALS_ENABLE
	bool "Support prize_dual_camera_als function"
	default n
	help
		 Select Y to enable prize_dual_camera_als function
		 
config PRIZE_DUAL_CAMERA_ENABLE_ALS_REAR
	bool "Support prize_dual_camera_als rear function"
	default n
	select PRIZE_DUAL_CAMERA_ENABLE
	help
		Select Y to enable prize_dual_camera_als function
		 
config PRIZE_DUAL_CAMERA_ENABLE_ALS_FRONT
	bool "Support prize_dual_camera_als front function"
	default n
	select PRIZE_DUAL_CAMERA_ENABLE
	help
		Select Y to enable prize_dual_camera_als function
```

## drivers/misc/mediatek/sensor/2.0/Kconfig
```kconfig
source "drivers/misc/mediatek/sensor/2.0/lsm6dsm_secondary/Kconfig"
source "drivers/misc/mediatek/sensor/2.0/test/Kconfig"

# begin, prize-lifenfen-20181126, add for sensorhub hardware info
config SENSORHUB_PRIZE_HARDWARE_INFO
	depends on NANOHUB
        bool "SENSORHUB PRIZE HARDWARE INFO support"
        help
          Kernel space sensor hub driver hardware info.

config SENSORHUB_PRIZE_HARDWARE_INFO_SIZE
        depends on NANOHUB
        bool "SENSORHUB PRIZE HARDWARE INFO SIZE support"
        help
          Kernel space sensor hub driver hardware info size.
# end, prize-lifenfen-20181126, add for sensorhub hardware info
```
